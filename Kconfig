## Kconfig
```kconfig
# Copyright (c) 2024 Aaron Chan
# SPDX-License-Identifier: Apache-2.0

# Note this should be configured by pins
config DEFAULT_RECEIVE_MODE
    bool "Startup defaults to receive mode"
    default n
```

## apps/hunter/cmake-build-outlaw-debug/Kconfig/Kconfig.shield.defconfig
```kconfig
osource "/home/aaron/Development/Outlaw/Outlaw-GPS-Tracker-Firmware/boards/shields/*/Kconfig.defconfig"
```

## apps/hunter/cmake-build-outlaw-debug/Kconfig/arch/Kconfig
```kconfig
# Load Zephyr Arch Kconfig descriptions.
osource "/home/aaron/Development/Outlaw/zephyr/arch/rx/Kconfig"
osource "/home/aaron/Development/Outlaw/zephyr/arch/x86/Kconfig"
osource "/home/aaron/Development/Outlaw/zephyr/arch/xtensa/Kconfig"
osource "/home/aaron/Development/Outlaw/zephyr/arch/sparc/Kconfig"
osource "/home/aaron/Development/Outlaw/zephyr/arch/riscv/Kconfig"
osource "/home/aaron/Development/Outlaw/zephyr/arch/posix/Kconfig"
osource "/home/aaron/Development/Outlaw/zephyr/arch/mips/Kconfig"
osource "/home/aaron/Development/Outlaw/zephyr/arch/arm64/Kconfig"
osource "/home/aaron/Development/Outlaw/zephyr/arch/arm/Kconfig"
osource "/home/aaron/Development/Outlaw/zephyr/arch/arc/Kconfig"
```

## apps/hunter/cmake-build-outlaw-debug/Kconfig/boards/Kconfig
```kconfig
# Load Zephyr board Kconfig descriptions.
osource "/home/aaron/Development/Outlaw/Outlaw-GPS-Tracker-Firmware/boards/deputy/Kconfig"
config BOARD_REVISION_1
	def_bool y
```

## apps/hunter/cmake-build-outlaw-debug/Kconfig/boards/Kconfig.defconfig
```kconfig
# Load Zephyr board defconfig descriptions.
osource "/home/aaron/Development/Outlaw/Outlaw-GPS-Tracker-Firmware/boards/deputy/Kconfig.defconfig"
```

## apps/hunter/cmake-build-outlaw-debug/Kconfig/boards/Kconfig.sysbuild.tmp
```kconfig
# Load Sysbuild board Kconfig descriptions.
osource "/home/aaron/Development/Outlaw/Outlaw-GPS-Tracker-Firmware/boards/deputy/Kconfig.sysbuild"
```

## apps/hunter/cmake-build-outlaw-debug/Kconfig/boards/Kconfig.tmp
```kconfig
# Load Zephyr board Kconfig descriptions.
osource "/home/aaron/Development/Outlaw/Outlaw-GPS-Tracker-Firmware/boards/deputy/Kconfig"
```

## apps/hunter/cmake-build-outlaw-debug/Kconfig/soc/Kconfig
```kconfig
# Load Zephyr SoC Kconfig descriptions.
osource "/home/aaron/Development/Outlaw/zephyr/soc/xlnx/zynqmp/Kconfig"
osource "/home/aaron/Development/Outlaw/zephyr/soc/xlnx/zynq7000/Kconfig"
osource "/home/aaron/Development/Outlaw/zephyr/soc/xlnx/versalnet/Kconfig"
osource "/home/aaron/Development/Outlaw/zephyr/soc/xlnx/versal2/Kconfig"
osource "/home/aaron/Development/Outlaw/zephyr/soc/xlnx/versal/Kconfig"
osource "/home/aaron/Development/Outlaw/zephyr/soc/xen/Kconfig"
osource "/home/aaron/Development/Outlaw/zephyr/soc/wch/ch32v/Kconfig"
osource "/home/aaron/Development/Outlaw/zephyr/soc/ti/simplelink/Kconfig"
osource "/home/aaron/Development/Outlaw/zephyr/soc/ti/mspm0/Kconfig"
osource "/home/aaron/Development/Outlaw/zephyr/soc/ti/lm3s6965/Kconfig"
osource "/home/aaron/Development/Outlaw/zephyr/soc/ti/k3/Kconfig"
osource "/home/aaron/Development/Outlaw/zephyr/soc/telink/tlsr/Kconfig"
osource "/home/aaron/Development/Outlaw/zephyr/soc/starfive/jh71xx/Kconfig"
osource "/home/aaron/Development/Outlaw/zephyr/soc/st/stm32/Kconfig"
osource "/home/aaron/Development/Outlaw/zephyr/soc/snps/qemu_arc/Kconfig"
osource "/home/aaron/Development/Outlaw/zephyr/soc/snps/nsim/arc_v/Kconfig"
osource "/home/aaron/Development/Outlaw/zephyr/soc/snps/nsim/arc_classic/Kconfig"
osource "/home/aaron/Development/Outlaw/zephyr/soc/snps/hsdk4xd/Kconfig"
osource "/home/aaron/Development/Outlaw/zephyr/soc/snps/hsdk/Kconfig"
osource "/home/aaron/Development/Outlaw/zephyr/soc/snps/emsk/Kconfig"
osource "/home/aaron/Development/Outlaw/zephyr/soc/snps/emsdp/Kconfig"
osource "/home/aaron/Development/Outlaw/zephyr/soc/snps/arc_iot/Kconfig"
osource "/home/aaron/Development/Outlaw/zephyr/soc/silabs/Kconfig"
osource "/home/aaron/Development/Outlaw/zephyr/soc/sifli/sf32/Kconfig"
osource "/home/aaron/Development/Outlaw/zephyr/soc/sifive/sifive_freedom/Kconfig"
osource "/home/aaron/Development/Outlaw/zephyr/soc/sensry/Kconfig"
osource "/home/aaron/Development/Outlaw/zephyr/soc/rockchip/Kconfig"
osource "/home/aaron/Development/Outlaw/zephyr/soc/renode/riscv_virtual/Kconfig"
osource "/home/aaron/Development/Outlaw/zephyr/soc/renode/cortex_r8_virtual/Kconfig"
osource "/home/aaron/Development/Outlaw/zephyr/soc/renesas/smartbond/Kconfig"
osource "/home/aaron/Development/Outlaw/zephyr/soc/renesas/rz/Kconfig"
osource "/home/aaron/Development/Outlaw/zephyr/soc/renesas/rx/Kconfig"
osource "/home/aaron/Development/Outlaw/zephyr/soc/renesas/rcar/Kconfig"
osource "/home/aaron/Development/Outlaw/zephyr/soc/renesas/ra/Kconfig"
osource "/home/aaron/Development/Outlaw/zephyr/soc/realtek/ec/Kconfig"
osource "/home/aaron/Development/Outlaw/zephyr/soc/realtek/ameba/Kconfig"
osource "/home/aaron/Development/Outlaw/zephyr/soc/raspberrypi/rpi_pico/Kconfig"
osource "/home/aaron/Development/Outlaw/zephyr/soc/quicklogic/eos_s3/Kconfig"
osource "/home/aaron/Development/Outlaw/zephyr/soc/qemu/virt_riscv/Kconfig"
osource "/home/aaron/Development/Outlaw/zephyr/soc/qemu/malta/Kconfig"
osource "/home/aaron/Development/Outlaw/zephyr/soc/openisa/rv32m1/Kconfig"
osource "/home/aaron/Development/Outlaw/zephyr/soc/openhwgroup/cva6/Kconfig"
osource "/home/aaron/Development/Outlaw/zephyr/soc/oct/osd32mp15x/Kconfig"
osource "/home/aaron/Development/Outlaw/zephyr/soc/nxp/s32/Kconfig"
osource "/home/aaron/Development/Outlaw/zephyr/soc/nxp/rw/Kconfig"
osource "/home/aaron/Development/Outlaw/zephyr/soc/nxp/mcx/Kconfig"
osource "/home/aaron/Development/Outlaw/zephyr/soc/nxp/lpc/Kconfig"
osource "/home/aaron/Development/Outlaw/zephyr/soc/nxp/layerscape/Kconfig"
osource "/home/aaron/Development/Outlaw/zephyr/soc/nxp/kinetis/Kconfig"
osource "/home/aaron/Development/Outlaw/zephyr/soc/nxp/imxrt/Kconfig"
osource "/home/aaron/Development/Outlaw/zephyr/soc/nxp/imx/Kconfig"
osource "/home/aaron/Development/Outlaw/zephyr/soc/nuvoton/numicro/Kconfig"
osource "/home/aaron/Development/Outlaw/zephyr/soc/nuvoton/numaker/Kconfig"
osource "/home/aaron/Development/Outlaw/zephyr/soc/nuvoton/npcx/Kconfig"
osource "/home/aaron/Development/Outlaw/zephyr/soc/nuvoton/npcm/Kconfig"
osource "/home/aaron/Development/Outlaw/zephyr/soc/nordic/Kconfig"
osource "/home/aaron/Development/Outlaw/zephyr/soc/neorv32/Kconfig"
osource "/home/aaron/Development/Outlaw/zephyr/soc/native/inf_clock/Kconfig"
osource "/home/aaron/Development/Outlaw/zephyr/soc/microchip/sam/sama7/Kconfig"
osource "/home/aaron/Development/Outlaw/zephyr/soc/microchip/sam/sam_d5x_e5x/Kconfig"
osource "/home/aaron/Development/Outlaw/zephyr/soc/microchip/pic32c/pic32cz_ca/Kconfig"
osource "/home/aaron/Development/Outlaw/zephyr/soc/microchip/pic32c/pic32cx_sg/Kconfig"
osource "/home/aaron/Development/Outlaw/zephyr/soc/microchip/pic32c/pic32cm_jh/Kconfig"
osource "/home/aaron/Development/Outlaw/zephyr/soc/microchip/miv/Kconfig"
osource "/home/aaron/Development/Outlaw/zephyr/soc/microchip/mec/Kconfig"
osource "/home/aaron/Development/Outlaw/zephyr/soc/mediatek/mt8xxx/Kconfig"
osource "/home/aaron/Development/Outlaw/zephyr/soc/lowrisc/opentitan/Kconfig"
osource "/home/aaron/Development/Outlaw/zephyr/soc/litex/litex_vexriscv/Kconfig"
osource "/home/aaron/Development/Outlaw/zephyr/soc/ite/ec/Kconfig"
osource "/home/aaron/Development/Outlaw/zephyr/soc/intel/wildcat_lake/Kconfig"
osource "/home/aaron/Development/Outlaw/zephyr/soc/intel/raptor_lake/Kconfig"
osource "/home/aaron/Development/Outlaw/zephyr/soc/intel/panther_lake/Kconfig"
osource "/home/aaron/Development/Outlaw/zephyr/soc/intel/lakemont/Kconfig"
osource "/home/aaron/Development/Outlaw/zephyr/soc/intel/intel_socfpga_std/Kconfig"
osource "/home/aaron/Development/Outlaw/zephyr/soc/intel/intel_socfpga/Kconfig"
osource "/home/aaron/Development/Outlaw/zephyr/soc/intel/intel_niosv/Kconfig"
osource "/home/aaron/Development/Outlaw/zephyr/soc/intel/intel_ish/Kconfig"
osource "/home/aaron/Development/Outlaw/zephyr/soc/intel/intel_adsp/Kconfig"
osource "/home/aaron/Development/Outlaw/zephyr/soc/intel/elkhart_lake/Kconfig"
osource "/home/aaron/Development/Outlaw/zephyr/soc/intel/atom/Kconfig"
osource "/home/aaron/Development/Outlaw/zephyr/soc/intel/apollo_lake/Kconfig"
osource "/home/aaron/Development/Outlaw/zephyr/soc/intel/alder_lake/Kconfig"
osource "/home/aaron/Development/Outlaw/zephyr/soc/infineon/psoc4/Kconfig"
osource "/home/aaron/Development/Outlaw/zephyr/soc/infineon/edge/Kconfig"
osource "/home/aaron/Development/Outlaw/zephyr/soc/infineon/cat3/Kconfig"
osource "/home/aaron/Development/Outlaw/zephyr/soc/infineon/cat1c/Kconfig"
osource "/home/aaron/Development/Outlaw/zephyr/soc/infineon/cat1b/Kconfig"
osource "/home/aaron/Development/Outlaw/zephyr/soc/infineon/cat1a/Kconfig"
osource "/home/aaron/Development/Outlaw/zephyr/soc/gd/gd32/Kconfig"
osource "/home/aaron/Development/Outlaw/zephyr/soc/gaisler/leon3/Kconfig"
osource "/home/aaron/Development/Outlaw/zephyr/soc/gaisler/gr716a/Kconfig"
osource "/home/aaron/Development/Outlaw/zephyr/soc/focaltech/Kconfig"
osource "/home/aaron/Development/Outlaw/zephyr/soc/espressif/Kconfig"
osource "/home/aaron/Development/Outlaw/zephyr/soc/ene/kb1200/Kconfig"
osource "/home/aaron/Development/Outlaw/zephyr/soc/ene/kb106x/Kconfig"
osource "/home/aaron/Development/Outlaw/zephyr/soc/egis/Kconfig"
osource "/home/aaron/Development/Outlaw/zephyr/soc/efinix/sapphire/Kconfig"
osource "/home/aaron/Development/Outlaw/zephyr/soc/cdns/xtensa_sample_controller/Kconfig"
osource "/home/aaron/Development/Outlaw/zephyr/soc/cdns/sample_controller32/Kconfig"
osource "/home/aaron/Development/Outlaw/zephyr/soc/cdns/dc233c/Kconfig"
osource "/home/aaron/Development/Outlaw/zephyr/soc/brcm/bcmvk/Kconfig"
osource "/home/aaron/Development/Outlaw/zephyr/soc/brcm/bcm2712/Kconfig"
osource "/home/aaron/Development/Outlaw/zephyr/soc/brcm/bcm2711/Kconfig"
osource "/home/aaron/Development/Outlaw/zephyr/soc/bflb/Kconfig"
osource "/home/aaron/Development/Outlaw/zephyr/soc/atmel/sam0/Kconfig"
osource "/home/aaron/Development/Outlaw/zephyr/soc/atmel/sam/Kconfig"
osource "/home/aaron/Development/Outlaw/zephyr/soc/aspeed/Kconfig"
osource "/home/aaron/Development/Outlaw/zephyr/soc/arm/Kconfig"
osource "/home/aaron/Development/Outlaw/zephyr/soc/arm/beetle/Kconfig"
osource "/home/aaron/Development/Outlaw/zephyr/soc/antmicro/myra/Kconfig"
osource "/home/aaron/Development/Outlaw/zephyr/soc/andestech/Kconfig"
osource "/home/aaron/Development/Outlaw/zephyr/soc/amd/acp_6_0/Kconfig"
osource "/home/aaron/Development/Outlaw/zephyr/soc/ambiq/Kconfig"
osource "/home/aaron/Development/Outlaw/zephyr/soc/aesc/Kconfig"
osource "/home/aaron/Development/Outlaw/zephyr/soc/adi/max32/Kconfig"
```

## boards/deputy/board.yml
```yaml
board:
  name: deputy
  full_name: Deputy Receiver
  vendor: Wild West Rocketry
  revision:
    format: number
    default: "1"
    revisions:
      - name: "1"
      - name: "2"
  socs:
    - name: stm32f030x8
```

## boards/deputy/deputy_defconfig
```kconfig
# SPDX-License-Identifier: Apache-2.0

# enable uart driver
CONFIG_SERIAL=y
CONFIG_CONSOLE=y
CONFIG_UART_CONSOLE=y

# enable GPIO
CONFIG_GPIO=y
CONFIG_DEFAULT_RECEIVE_MODE=y
CONFIG_LOG=y
CONFIG_LOG_MODE_IMMEDIATE=y # RAM will overflow if we don't immediately flush logs
#CONFIG_LORA_LOG_LEVEL_DBG=y
#CONFIG_GPIO_LOG_LEVEL_DBG=y
#CONFIG_SPI_LOG_LEVEL_DBG=y
```

## boards/hunter/board.yml
```yaml
board:
  name: hunter
  full_name: Hunter Receiver
  vendor: Wild West Rocketry
  revision:
    format: number
    default: "1"
    revisions:
      - name: "1"
      - name: "2"
  socs:
    - name: stm32f030x8
```

## boards/outlaw/board.yml
```yaml
board:
  name: outlaw
  full_name: Outlaw GPS Tracker
  vendor: Wild West Rocketry
  socs:
    - name: stm32f030xe
```

## boards/outlaw_gen2/board.yml
```yaml
board:
  name: outlaw_gen2
  full_name: Outlaw GPS Tracker Gen 2
  vendor: Wild West Rocketry
  socs:
    - name: stm32f103xe
```

## boards/outlaw_gen3/outlaw_gen3_defconfig
```kconfig
# SPDX-License-Identifier: Apache-2.0

# enable uart driver
CONFIG_SERIAL=y
# enable console
CONFIG_CONSOLE=y
CONFIG_UART_CONSOLE=y

# enable GPIO
CONFIG_GPIO=y
CONFIG_DEFAULT_RECEIVE_MODE=n

# USB
CONFIG_USB_DEVICE_STACK=y
CONFIG_USB_CDC_ACM=y
CONFIG_USB_CDC_ACM_LIB=y
CONFIG_MCUBOOT_USB_DFU=y
CONFIG_USB_DFU_DEVICE_STACK=y
```

## lib/core/Kconfig
```kconfig
config CORE
  bool "Core"
  help
    This option enables core functionality for tracker software

config LICENSED_FREQUENCY
  bool "Licensed Frequency"
  depends on CORE
  help
    This option enables callsigns prepended to each packet.

config SHELL_FREQUENCY
  bool "Shell Frequency"
  depends on CORE
  help
    This option enables a shell command to set the frequency at runtime.

config SHELL_CALLSIGN
  bool "Shell Callsign"
  depends on CORE
  help
    This option enables a shell command to set the callsign at runtime.

config SHELL_NODE_ID
  bool "Shell Node ID"
  depends on CORE
  help
    This option enables a shell command to set the node ID at runtime.
```
