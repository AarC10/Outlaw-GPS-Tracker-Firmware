## CMakeLists.txt
```
cmake_minimum_required(VERSION 3.13.1)
find_package(Zephyr REQUIRED HINTS $ENV{ZEPHYR_BASE})

project(receiver LANGUAGES C)

target_include_directories(app PRIVATE include)
target_sources(app PRIVATE src/main.cpp)
```

## prj.conf
```kconfig
# Copyright (c) 2024 Aaron Chan
# SPDX-License-Identifier: Apache-2.0
CONFIG_LORA=y
CONFIG_LOG=y
CONFIG_CBPRINTF_FP_SUPPORT=y

CONFIG_UART_INTERRUPT_DRIVEN=y
CONFIG_CONSOLE=y
CONFIG_PRINTK=y
CONFIG_UART_CONSOLE=y
CONFIG_LOG_BACKEND_UART=y
CONFIG_SERIAL=y
CONFIG_CORE=y
CONFIG_LOG_MODE_IMMEDIATE=y
CONFIG_LOG_MODE_DEFERRED=n
#CONFIG_LORA_LOG_LEVEL_DBG=y
CONFIG_LORA_LOG_LEVEL_ERR=y
CONFIG_CPP=y
CONFIG_REQUIRES_FULL_LIBCPP=y
CONFIG_STD_CPP23=y

CONFIG_MAIN_STACK_SIZE=2048

# Need more memory :(
#CONFIG_SHELL=y

CONFIG_FLASH=y
CONFIG_FLASH_MAP=y
CONFIG_NVS=y
CONFIG_SETTINGS=y
CONFIG_SETTINGS_NVS=y
CONFIG_MPU_ALLOW_FLASH_WRITE=y
```

## src/main.c
```c
/*
 * Copyright (c) 2024 Aaron Chan
 * SPDX-License-Identifier: Apache-2.0
 */

#include <zephyr/kernel.h>
#include <zephyr/device.h>
#include <zephyr/logging/log.h>
#include <zephyr/drivers/lora.h>
#include <zephyr/logging/log_ctrl.h>

#include <core/lora.h>


LOG_MODULE_REGISTER(main);

int main(void) {
    lora_init();
    lora_set_rx();

    while (true) {
        lora_await_rx_packet();

    }

    return 0;
}
```

## src/main.cpp
```c
/*
 * Copyright (c) 2024 Aaron Chan
 * SPDX-License-Identifier: Apache-2.0
 */

#include <zephyr/kernel.h>
#include <zephyr/device.h>
#include <zephyr/logging/log.h>
#include <zephyr/logging/log_ctrl.h>

#include "core/LoraTransceiver.h"
#include "core/Settings.h"


LOG_MODULE_REGISTER(main);

int main(void) {
    // Settings::load();
    // float freqMHz = static_cast<float>(OutlawSettings::getFrequency()) / 1'000'000;
#ifdef CONFIG_LICENSED_FREQUENCY
    float freqMhz = 435.0f;
#else
    float freqMhz = 903.0f;
#endif
    LoraTransceiver lora(0, freqMhz);
    lora.awaitRxPacket();

    while (true) {
        k_sleep(K_FOREVER);
    }

    return 0;
}
```
