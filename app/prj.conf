## CMakeLists.txt
```
cmake_minimum_required(VERSION 3.13.1)
find_package(Zephyr REQUIRED HINTS $ENV{ZEPHYR_BASE})

project(app LANGUAGES C)

target_include_directories(app PRIVATE include)
target_sources(app PRIVATE src/main.c src/state_machine.c)
```

## prj.conf
```kconfig
# Copyright (c) 2024 Aaron Chan
# SPDX-License-Identifier: Apache-2.0

CONFIG_SMF=y
CONFIG_LORA=y
CONFIG_LOG=y
CONFIG_CBPRINTF_FP_SUPPORT=y
CONFIG_GNSS=y
CONFIG_GNSS_SATELLITES=y
CONFIG_GNSS_NMEA0183=y
CONFIG_UART_INTERRUPT_DRIVEN=y
CONFIG_CONSOLE=y
CONFIG_PRINTK=y
CONFIG_UART_CONSOLE=y
CONFIG_LOG_BACKEND_UART=y
CONFIG_SERIAL=y
CONFIG_CORE=y
CONFIG_COUNTER=y
CONFIG_CPP=y
CONFIG_REQUIRES_FULL_LIBCPP=y
CONFIG_STD_CPP23=y


CONFIG_MAIN_STACK_SIZE=2048
#CONFIG_LORA_LOG_LEVEL_DBG=y

CONFIG_SHELL=y

CONFIG_FLASH=y
CONFIG_FLASH_MAP=y
CONFIG_NVS=y
CONFIG_SETTINGS=y
CONFIG_SETTINGS_NVS=y
CONFIG_MPU_ALLOW_FLASH_WRITE=y

CONFIG_SHELL_FREQUENCY=y
CONFIG_SHELL_CALLSIGN=n
CONFIG_SHELL_NODE_ID=y
```

## boards/nucleo_f302r8.overlay
```dts
/*
 * Copyright (c) 2024 Aaron Chan
 * SPDX-License-Identifier: Apache-2.0
 */

/* This devicetree overlay file will be automatically picked by the Zephyr
 * build system when building the sample for the nucleo_f302r8 board. It shows
 * how the example-application can be built on sample boards already provided
 * by Zephyr.
 */

/ {
	example_sensor: example-sensor {
		compatible = "zephyr,example-sensor";
		input-gpios = <&gpioc 13 (GPIO_PULL_UP | GPIO_ACTIVE_LOW)>;
	};

	blink_led: blink-led {
		compatible = "blink-gpio-led";
		led-gpios = <&gpiob 13 GPIO_ACTIVE_HIGH>;
		blink-period-ms = <1000>;
	};
};

&gpioc {
	status = "okay";
};
```

## src/main.c
```c
/*
 * Copyright (c) 2024 Aaron Chan
 * SPDX-License-Identifier: Apache-2.0
 */

#include <zephyr/kernel.h>
#include <zephyr/device.h>
#include <zephyr/logging/log.h>
#include <zephyr/drivers/gnss.h>
#include <zephyr/drivers/lora.h>
#include <zephyr/drivers/gpio.h>
#include <zephyr/logging/log_ctrl.h>
#include <core/lora.h>
#include <core/time.h>
#include <core/defs.h>
#include <core/tdma.h>
#include <core/gnss.h>

#include "state_machine.h"

LOG_MODULE_REGISTER(main);
GNSS_DATA_CALLBACK_DEFINE(DEVICE_DT_GET(DT_ALIAS(gnss)), gnss_data_callback);

int main(void) {
    static const struct gpio_dt_spec pps_spec = GPIO_DT_SPEC_GET(DT_ALIAS(pps), gpios);
    static const struct gpio_dt_spec led = GPIO_DT_SPEC_GET(DT_ALIAS(led0), gpios);
    if (!device_is_ready(led.port)) {
        LOG_ERR("LED GPIO device not ready\n");
    }

    state_machine_init();
    lora_init();
    time_setup_pps(&pps_spec);


    while (true) {
        const int ret = state_machine_run();
        if (ret != 0) {
            LOG_ERR("state_machine_run returned %d", ret);
            k_sleep(K_SECONDS(1));
        }

        k_sleep(K_MSEC(100));
    }

    return 0;
}
```

## src/main.cpp
```c
/*
 * Copyright (c) 2024 Aaron Chan
 * SPDX-License-Identifier: Apache-2.0
 */

#include <zephyr/kernel.h>
#include <zephyr/device.h>
#include <zephyr/logging/log.h>
#include <zephyr/drivers/gnss.h>
#include <zephyr/drivers/lora.h>
#include <zephyr/drivers/gpio.h>
#include <zephyr/logging/log_ctrl.h>
#include <core/time.h>
#include <core/defs.h>
#include <core/tdma.h>
#include <core/LoraTransceiver.h>
#include <core/HamCallsign.h>
#include "state_machine.h"
#include <core/GnssReceiver.h>
#include <core/Settings.h>

LOG_MODULE_REGISTER(main);
GNSS_DATA_CALLBACK_DEFINE(DEVICE_DT_GET(DT_ALIAS(gnss)), gnssCallback);

int main() {
    static const gpio_dt_spec pps_spec = GPIO_DT_SPEC_GET(DT_ALIAS(pps), gpios);
    static const gpio_dt_spec led = GPIO_DT_SPEC_GET(DT_ALIAS(led0), gpios);
    if (!device_is_ready(led.port)) {
        LOG_ERR("LED GPIO device not ready\n");
    }

    Settings::load();
    const uint8_t nodeId = Settings::getNodeId();
    const uint32_t freqHz = Settings::getFrequency();
    const float freqMHz = static_cast<float>(freqHz) / 1'000'000;
#ifdef CONFIG_LICENSED_FREQUENCY
    const char callsignBuff[Settings::CALLSIGN_LEN] = {};
    Settings::getCallsign(const_cast<char*>(callsignBuff));
    const HamCallsign callsign(callsignBuff);
    StateMachine sm(nodeId, freqMHz, callsign);
#else
    StateMachine sm(nodeId, freqMHz);
#endif

    time_setup_pps(&pps_spec);

    while (true) {
        const int ret = sm.run();
        if (ret != 0) {
            LOG_ERR("state_machine_run returned %d", ret);
            k_sleep(K_SECONDS(1));
        }

        k_sleep(K_MSEC(100));
    }

    return 0;
}
```

## include/gnss_helper.h
```c
#ifndef GNSS_HELPER_H
#define GNSS_HELPER_H

#include <stdint.h>
#include <zephyr/drivers/gnss.h> // Might as well include here since users of this header need to use the macro for setting up callbacks

void gnss_data_cb(const struct device *dev, const struct gnss_data *data);

void gnss_satellites_cb(const struct device *dev, const struct gnss_satellite *satellites, uint16_t size);

#endif //GNSS_HELPER_H
```

## include/settings.h
```c
#ifndef OUTLAW_SETTINGS_H
#define OUTLAW_SETTINGS_H

#endif //OUTLAW_SETTINGS_H
```

## include/state_machine.h
```c
#pragma once

#include <stdint.h>
#include <zephyr/kernel.h>

#include "core/GnssReceiver.h"
#include "core/LoraTransceiver.h"

class StateMachine {
public:
#ifdef CONFIG_LICENSED_FREQUENCY
    explicit StateMachine(uint8_t nodeId, const float frequencyMHz = 903.0, const HamCallsign& callsign = HamCallsign());
#else
    explicit StateMachine(uint8_t nodeId, const float frequencyMHz = 903.0);
#endif
    void handleTxTimer();

    int run();

private:
    enum class State { Transmitter, Receiver };

    void enterTransmitter();
    void enterReceiver();
    void exitReceiver();
    void transitionTo(State target);
    int checkForTransition();

#ifdef CONFIG_LICENSED_FREQUENCY
    HamCallsign callsign;
#endif
    LoraTransceiver lora;
    GnssReceiver gnssReceiver;
    k_timer txTimer{};
    uint8_t nodeId{};
    int lastPinSate{-1};
    State currentState{State::Transmitter};
};
```

## src/gnss_helper.c
```c
#include "gnss_helper.h"

#include <zephyr/device.h>
#include <zephyr/drivers/gnss.h>
#include <zephyr/logging/log.h>

LOG_MODULE_REGISTER(gnss_helper);

void gnss_data_cb(const struct device *dev, const struct gnss_data *data) {
    if (data->info.fix_status != GNSS_FIX_STATUS_NO_FIX) {
        LOG_INF("Fix acquired!");
    } else {
        LOG_INF("No fix acquired!");
    }
}


void gnss_satellites_cb(const struct device *dev, const struct gnss_satellite *satellites, uint16_t size) {
    LOG_INF("Locked with %u satellites!", dev->name, size);
}
```

## src/settings.cpp
```c
#include "include/settings.h"
```

## src/state_machine.c
```c
#include "state_machine.h"

#include <core/lora.h>
#include <core/gnss.h>

#include <zephyr/drivers/gnss.h>
#include <zephyr/drivers/gpio.h>
#include <zephyr/kernel.h>
#include <zephyr/logging/log.h>
#include <zephyr/smf.h>

#define TRANSMITTER_LOGIC_LEVEL 0
#define TRANSMITTER_LED_LEVEL 0

#define RECEIVER_LOGIC_LEVEL 1
#define RECEIVER_LED_LEVEL 1

LOG_MODULE_REGISTER(state_machine);


static const struct gpio_dt_spec dip0 = GPIO_DT_SPEC_GET(DT_ALIAS(dip0), gpios);
static const struct gpio_dt_spec led = GPIO_DT_SPEC_GET(DT_ALIAS(led0), gpios);

static void tx_timer_handler(struct k_timer* timer_id) {
    uint8_t node_id = POINTER_TO_UINT(k_timer_user_data_get(timer_id));

    static uint8_t payload[sizeof(lora_payload_t) + 1] = {0};
    payload[0] = node_id;
    lora_payload_t* lora_payload = (lora_payload_t*)&payload[1];

    if (gnss_fix_acquired()) {
        gnss_populate_lora_payload(lora_payload);
        lora_tx(payload, sizeof(lora_payload_t) + 1);
    } else {
        LOG_INF("Sending NOFIX");
        lora_send_no_fix_payload(node_id);
        gpio_pin_toggle_dt(&led);
    }
}

K_TIMER_DEFINE(tx_timer, tx_timer_handler, NULL);

static const struct smf_state states[];

enum demo_state { transmitter, receiver };

struct s_object {
    struct smf_ctx ctx;
} smf_obj;

static enum smf_state_result check_for_transition(void*) {
    static int last_pin_state = -1;
    const int current_pin_state = gpio_pin_get_dt(&dip0);
    LOG_DBG("Pin state: %d", current_pin_state);

    if (current_pin_state < 0) {
        LOG_DBG("dip0 gpio read error (%d); ignoring transition check", current_pin_state);
        return SMF_EVENT_HANDLED;
    }

    if (last_pin_state != current_pin_state) {
        if (current_pin_state == TRANSMITTER_LOGIC_LEVEL) {
            smf_set_state(SMF_CTX(&smf_obj), &states[transmitter]);
        } else if (current_pin_state == RECEIVER_LOGIC_LEVEL) {
            smf_set_state(SMF_CTX(&smf_obj), &states[receiver]);
        }
    }

    last_pin_state = current_pin_state;

    return SMF_EVENT_HANDLED;
}

static void transmitter_entry(void*) {
    LOG_INF("Entering transmitter state");
    lora_set_tx();
    gpio_pin_set_dt(&led, TRANSMITTER_LED_LEVEL);
    k_timer_start(&tx_timer, K_SECONDS(5), K_SECONDS(5));
}

static void receiver_entry(void*) {
    LOG_INF("Entering receiver state");
    lora_set_rx();
    gpio_pin_set_dt(&led, RECEIVER_LED_LEVEL);
    k_timer_stop(&tx_timer);
    lora_await_rx_packet();
}

static void receiver_exit(void*) {
    lora_await_cancel();
}

static const struct smf_state states[] = {
    [transmitter] = SMF_CREATE_STATE(transmitter_entry, check_for_transition, NULL, NULL, NULL),
    [receiver] = SMF_CREATE_STATE(receiver_entry, check_for_transition, receiver_exit, NULL, NULL),
};

void state_machine_init(const uint8_t node_id) {
    k_timer_user_data_set(&tx_timer, UINT_TO_POINTER(node_id));

#ifdef CONFIG_DEFAULT_RECEIVE_MODE
    smf_set_initial(SMF_CTX(&smf_obj), &states[receiver]);
#else
    smf_set_initial(SMF_CTX(&smf_obj), &states[transmitter]);
#endif
}

int state_machine_run() {
    const int32_t ret = smf_run_state(SMF_CTX(&smf_obj));
    if (ret != 0) {
        LOG_ERR("State machine terminated with value: %d", ret);
    }
    return ret;
}
```

## src/state_machine.cpp
```c
#include "state_machine.h"

#include <zephyr/drivers/gnss.h>
#include <zephyr/drivers/gpio.h>
#include <zephyr/kernel.h>
#include <zephyr/logging/log.h>

static constexpr int TRANSMITTER_LOGIC_LEVEL = 0;
static constexpr int TRANSMITTER_LED_LEVEL = 0;

static constexpr int RECEIVER_LOGIC_LEVEL = 1;
static constexpr int RECEIVER_LED_LEVEL = 1;

LOG_MODULE_REGISTER(state_machine);

static const gpio_dt_spec dip0 = GPIO_DT_SPEC_GET(DT_ALIAS(dip0), gpios);
static const gpio_dt_spec led = GPIO_DT_SPEC_GET(DT_ALIAS(led0), gpios);

static void txTimerCallback(struct k_timer* timer) {
    if (auto* sm = static_cast<StateMachine*>(k_timer_user_data_get(timer))) {
        sm->handleTxTimer();
    }
}

#ifdef CONFIG_LICENSED_FREQUENCY
StateMachine::StateMachine(uint8_t nodeId, const float frequencyMHz, const HamCallsign& callsign) :  callsign(callsign), lora(nodeId, frequencyMHz), nodeId(nodeId) {
    k_timer_init(&txTimer, txTimerCallback, nullptr);
    k_timer_user_data_set(&txTimer, this);

#ifdef CONFIG_DEFAULT_RECEIVE_MODE
    currentState = State::Receiver;
    enterReceiver();
#else
    currentState = State::Transmitter;
    enterTransmitter();
#endif

    setGnssReciever(&gnssReceiver);
}

#else

StateMachine::StateMachine(const uint8_t nodeId, const float frequencyMhz) :  lora(nodeId, frequencyMhz), nodeId(nodeId) {
    k_timer_init(&txTimer, txTimerCallback, nullptr);
    k_timer_user_data_set(&txTimer, this);

#ifdef CONFIG_DEFAULT_RECEIVE_MODE
    currentState = State::Receiver;
    enterReceiver();
#else
    currentState = State::Transmitter;
    enterTransmitter();
#endif

    setGnssReciever(&gnssReceiver);
}

#endif


void StateMachine::handleTxTimer() {
    if (gnssReceiver.isFixAcquired()) {
        lora.txGnssPayload(gnssReceiver.getLatestData());
    } else {
        lora.txNoFixPayload();
    }
}

int StateMachine::run() {
    return checkForTransition();
}

void StateMachine::enterTransmitter() {
    LOG_INF("Entering transmitter state");
    lora.setTx();

    gpio_pin_set_dt(&led, TRANSMITTER_LED_LEVEL);
    k_timer_start(&txTimer, K_SECONDS(5), K_SECONDS(5));
}

void StateMachine::enterReceiver() {
    LOG_INF("Entering receiver state");
    lora.setRx();
    gpio_pin_set_dt(&led, RECEIVER_LED_LEVEL);
    k_timer_stop(&txTimer);
    lora.awaitRxPacket();
}

void StateMachine::exitReceiver() {
    lora.awaitCancel();
}

void StateMachine::transitionTo(State target) {
    if (target == currentState) {
        return;
    }

    if (currentState == State::Receiver) {
        exitReceiver();
    }

    currentState = target;

    if (currentState == State::Transmitter) {
        enterTransmitter();
    } else {
        enterReceiver();
    }
}

int StateMachine::checkForTransition() {
    const int current_pin_state = gpio_pin_get_dt(&dip0);
    LOG_DBG("Pin state: %d", current_pin_state);

    if (current_pin_state < 0) {
        LOG_DBG("dip0 gpio read error (%d); ignoring transition check", current_pin_state);
        return 0;
    }

    if (lastPinSate != current_pin_state) {
        if (current_pin_state == TRANSMITTER_LOGIC_LEVEL) {
            transitionTo(State::Transmitter);
        } else if (current_pin_state == RECEIVER_LOGIC_LEVEL) {
            transitionTo(State::Receiver);
        }
    }

    lastPinSate = current_pin_state;

    return 0;
}
```
